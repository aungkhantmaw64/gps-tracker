## components/network_manager/Kconfig
```kconfig
menu "Network Manager Configuration"

config GPS_TRACKER_WIFI_SSID
  string "WiFi SSID"
  default "gps-tracker"
  help
    Change this to your own router's SSID

config GPS_TRACKER_WIFI_PASSWORD
  string "WiFi Password"
  default "abcdefgh"
  help
    Change this to your own router's password
endmenu
```

## main/Kconfig.projbuild
```kconfig
menu "GPS Tracker Configuration"

  config GPS_TRACKER_SNTP_TIME_SERVER
    string "SNTP server name"
    default "pool.ntp.org"
    help
        Hostname of the main SNTP server.
 
  config GPS_TRACKER_SNTP_TIME_ZONE
    string "SNTP time zone"
    default "ICT-7"
    help
      Default time zone is Thailand

  config GPS_TRACKER_WIFI_SSID
    string "WiFi SSID"
    default "gps-tracker"
    help
      Change this to your own router's SSID

  config GPS_TRACKER_WIFI_PASSWORD
    string "WiFi Password"
    default "abcdefgh"
    help
      Change this to your own router's password

  config GPS_TRACKER_MQTT_BROKER_URL
    string "MQTT broker URL"
    default "mqtt://test.mosquitto.org"
    help
      Change this to your own router's password

endmenu
```

## sdkconfig.defaults
```kconfig
CONFIG_ESP_WIFI_ENABLE_WPA3_OWE_STA=n
CONFIG_ESP_WIFI_ENABLE_WPA3_SAE=n
CONFIG_ESP32_WIFI_ENABLE_WPA3_SAE=n
CONFIG_LWIP_DHCP_GET_NTP_SRV=y
CONFIG_SNTP_TIME_SERVER="time.navy.mi.th"
CONFIG_ESP_TIME_FUNCS_USE_RTC_TIMER=y
```
